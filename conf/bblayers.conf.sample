## conf/bblayers.conf.sample
```bitbake
LCONF_VERSION = "7"

BBPATH = "${TOPDIR}"
BBFILES ?= ""

BBLAYERS ?= " \
    ##OEROOT##/meta \
    ##OEROOT##/meta-poky \
    ##OEROOT##/../meta-openembedded/meta-perl \
    ##OEROOT##/../meta-openembedded/meta-python \
    ##OEROOT##/../meta-openembedded/meta-filesystems \
    ##OEROOT##/../meta-openembedded/meta-gnome \
    ##OEROOT##/../meta-openembedded/meta-multimedia \
    ##OEROOT##/../meta-openembedded/meta-networking \
    ##OEROOT##/../meta-openembedded/meta-webserver \
    ##OEROOT##/../meta-openembedded/meta-xfce \
    ##OEROOT##/../meta-openembedded/meta-initramfs \
    ##OEROOT##/../meta-openembedded/meta-oe \
    ##OEROOT##/../meta-clang \
    ##OEROOT##/../meta-browser/meta-chromium \
    ##OEROOT##/../meta-qt5 \
    ##OEROOT##/../meta-xilinx/meta-microblaze \
    ##OEROOT##/../meta-xilinx/meta-xilinx-core \
    ##OEROOT##/../meta-xilinx/meta-xilinx-bsp \
    ##OEROOT##/../meta-xilinx/meta-xilinx-pynq \
    ##OEROOT##/../meta-xilinx/meta-xilinx-contrib \
    ##OEROOT##/../meta-xilinx/meta-xilinx-standalone \
    ##OEROOT##/../meta-xilinx/meta-xilinx-vendor \
    ##OEROOT##/../meta-xilinx-tools \
    ##OEROOT##/../meta-petalinux \
    ##OEROOT##/../meta-virtualization \
    ##OEROOT##/../meta-openamp \
    ##OEROOT##/../meta-jupyter \
    ##OEROOT##/../meta-vitis \
    ##OEROOT##/../meta-python2 \
    ##OEROOT##/../meta-som \
    ##OEROOT##/../meta-security \
    ##OEROOT##/../meta-security/meta-tpm \
    ##OEROOT##/../meta-xilinx-tsn \
    ##OEROOT##/../meta-ros/meta-ros-common \
    ##OEROOT##/../meta-ros/meta-ros2 \
    ##OEROOT##/../meta-ros/meta-ros2-humble \
"

BBLAYERS_NON_REMOVABLE ?= " \
    ##OEROOT##/meta \
"
```

## conf/distro/default.conf
```bitbake
EMBEDDEDSW_SRCREV = "${AUTOREV}"
SRCREV:pn-device-tree = "${AUTOREV}"
SRCREV:pn-external-hdf = "${AUTOREV}"
SRCREV:pn-linux-xlnx = "${AUTOREV}"
SRCREV:pn-arm-trusted-firmware = "${AUTOREV}"
SRCREV:pn-u-boot-xlnx = "${AUTOREV}"
SRCREV:pn-libomxil-xlnx = "${AUTOREV}"
SRCREV:pn-libvcu-xlnx = "${AUTOREV}"
SRCREV:pn-vcu-firmware = "${AUTOREV}"
SRCREV:pn-kernel-module-vcu = "${AUTOREV}"
SRCREV:pn-qemu-devicetrees = "${AUTOREV}"
SRCREV:pn-qemu-xilinx = "${AUTOREV}"
SRCREV_gst-omx:pn-gstreamer1.0-omx = "${AUTOREV}"
SRCREV_base:pn-gstreamer1.0-plugins-bad = "${AUTOREV}"
SRCREV_base:pn-gstreamer1.0-plugins-base = "${AUTOREV}"
SRCREV_base:pn-gstreamer1.0-plugins-good = "${AUTOREV}"
```

## conf/distro/include/petalinux-features.conf
```bitbake
IMAGE_FSTYPES += "tar.gz cpio.gz.u-boot ext4 ${@'wic' if (d.getVar('INITRAMFS_IMAGE') or '') == '' else ''}"

POKY_DEFAULT_DISTRO_FEATURES = "${BUSYBOX_FEATURES} largefile pam ptest"

# If the hardware has mali graphics, use libmali
DISTRO_FEATURES:append:aarch64 = ' libmali'

# BusyBox features
BUSYBOX_FEATURES = " \
	busybox-hd \
	busybox-ftpd \
	busybox-ftp \
	busybox-telnetd \
	busybox-mdev \
	busybox-inetd \
	busybox-httpd \
	"

DISTRO_FEATURES_DEFAULT:microblaze = "ipv4 ipv6 xattr pni-names"
DISTRO_FEATURES_DEFAULT:zynq = "ipv4 ipv6 xattr pni-names"

# PetaLinux Default Distro features
PETALINUX_DEFAULT_DISTRO_FEATURES = "fbdev opengl openamp x11 ${PETALINUX_MISC_FEATURES}"

# Remove unsupported PetaLinux Default Distro features for microBlaze
PETALINUX_DEFAULT_DISTRO_FEATURES:microblaze = ""

# PetaLinux Miscellaneous features for aarch64
PETALINUX_MISC_FEATURES = "multiarch security tpm virtualization vmsep wayland xen rauc"

# For xen, we need to use the internal busybox
RUNX_USE_INTERNAL_BUSYBOX='1'

# Remove unsupported PetaLinux Miscellaneous features for zynq and microBlaze
PETALINUX_MISC_FEATURES:zynq = ""
PETALINUX_MISC_FEATURES:microblaze = ""

DISTRO_FEATURES = "${DISTRO_FEATURES_DEFAULT} ${POKY_DEFAULT_DISTRO_FEATURES} ${PETALINUX_DEFAULT_DISTRO_FEATURES}"

SKIP_META_VIRT_SANITY_CHECK:zynq = "1"
SKIP_META_SECURITY_SANITY_CHECK:zynq = "1"
SKIP_META_TPM_SANITY_CHECK:zynq = "1"
SKIP_META_VIRT_SANITY_CHECK:microblaze = "1"
SKIP_META_GNOME_SANITY_CHECK:microblaze = "1"
SKIP_META_SECURITY_SANITY_CHECK:microblaze = "1"
SKIP_META_TPM_SANITY_CHECK:microblaze = "1"

VIRTUAL-RUNTIME_dev_manager:microblaze = "busybox-mdev"
VIRTUAL-RUNTIME_login_manager = "busybox"

INIT_MANAGER_PLNX_DEFAULT = "systemd"
INIT_MANAGER_PLNX_DEFAULT:microblaze = "sysvinit"
INIT_MANAGER_PLNX_DEFAULT:zynq = "sysvinit"

INIT_MANAGER_DEFAULT ?= "${INIT_MANAGER_PLNX_DEFAULT}"

# The user can override INIT_MANAGER by setting INIT_MANAGER_DEFAULT
INIT_MANAGER = "${INIT_MANAGER_DEFAULT}"

# If we enable both systemd and sysvinit DISTRO_FEATURES, we
# need to ensure that the other one is not installed
PACKAGE_EXCLUDE:append = "${@bb.utils.contains('INIT_MANAGER','systemd',' sysvinit',' systemd',d)}"
# We also need to ensure that dev-pkgs doesn't accidently bring it in either
PACKAGE_EXCLUDE_COMPLEMENTARY:append = "${@bb.utils.contains('INIT_MANAGER','systemd',' sysvinit',' libsystemd libudev udev systemd',d)}"

# Update the default to include the vai sdk host packages
# Along with a simple way to turn it off!
PLNX_ADD_VAI_SDK ?= " nativesdk-packagegroup-protobuf-sdk-host"
PLNX_ADD_VAI_SDK:sdkmingw32 = ""
TOOLCHAIN_HOST_TASK:append = "${PLNX_ADD_VAI_SDK}"

PREFERRED_PROVIDER_iasl-native ?= "iasl-native"
PREFERRED_PROVIDER_virtual/runc = "runc-opencontainers"
PREFERRED_PROVIDER_virtual/containerd = "containerd-opencontainers"
PREFERRED_PROVIDER_start-jupyter = "start-jupyternb"
PREFERRED_PROVIDER_start-jupyter:kria = "start-jupyterlab"

UBOOT_SUFFIX = "bin"

# OpenAMP
PREFERRED_PROVIDER_libmetal ?= "libmetal-xlnx"
PREFERRED_PROVIDER_open-amp ?= "open-amp-xlnx"
```

## conf/distro/include/petalinux-feed.conf
```bitbake
PACKAGE_FEED_URIS ?= "http://petalinux.xilinx.com/sswreleases/rel-v${@d.getVar('XILINX_VER_MAIN').split('.')[0]}/generic/rpm"

# Package feed names always use '_', while ARCH names might include -
PACKAGE_FEED_ARCHS ?= "${@d.getVar('PACKAGE_ARCHS').replace('-','_')}"
```

## conf/distro/include/petalinux-mirrors.conf
```bitbake
INHERIT += "own-mirrors"
SOURCE_MIRROR_URL ?= "https://petalinux.xilinx.com/sswreleases/rel-v${XILINX_VER_MAIN}/downloads"

# QT code repository is often unavailable (503 or similar)
# Typically specified in meta-qt5/conf/layer.conf
QT_GIT ??= "git://code.qt.io/qt"
QT_MIRROR ?= "git://github.com/qt"
MIRRORS:append = " ${QT_GIT} ${QT_MIRROR}"
```

## conf/distro/include/petalinux-version.conf
```bitbake
# Main release version
XILINX_VER_MAIN = "2023.2"

# Set to "release" for major releases and "update-1" for update releases
XILINX_VER_UPDATE = "snapshot"

# This will be set in local.conf for CI builds
XILINX_VER_BUILD ?= "${@'${METADATA_REVISION}' if d.getVar('METADATA_REVISION') != '<unknown>' else 'unknown'}"

# Petalinux version
PETALINUX_VERSION = "${XILINX_VER_MAIN}"
```

## conf/distro/include/petalinux-versions.conf
```bitbake
SRCBRANCH_pn-libmetal = "master"
BRANCH_pn-libmetal = "master"
SRCREV_pn-libmetal = "${AUTOREV}"

SRCBRANCH_pn-open-amp = "master"
BRANCH_pn-open-amp = "master"
SRCREV_pn-open-amp = "${AUTOREV}"
```

## conf/distro/include/xilinx-mirrors.conf
```bitbake
# The following mirrors are only availble inside of the Xilinx network.

MIRRORS:append = "\
git://github.com/Xilinx/embeddedsw.git            git://gitenterprise.xilinx.com/embeddedsw/embeddedsw.git \n \
git://github.com/Xilinx/gst-omx.git               git://gitenterprise.xilinx.com/GStreamer/gst-omx.git \n \
git://github.com/Xilinx/gst-plugins-bad.git       git://gitenterprise.xilinx.com/GStreamer/gst-plugins-bad.git \n \
git://github.com/Xilinx/gst-plugins-base.git      git://gitenterprise.xilinx.com/GStreamer/gst-plugins-base.git \n \
git://github.com/Xilinx/gst-plugins-good.git      git://gitenterprise.xilinx.com/GStreamer/gst-plugins-good.git \n \
git://github.com/Xilinx/gstreamer.git             git://gitenterprise.xilinx.com/GStreamer/gstreamer.git \n \
git://github.com/Xilinx/hdmi-modules.git          git://gitenterprise.xilinx.com/ipssw/hdmi-modules.git \n \
git://github.com/Xilinx/arm-trusted-firmware.git  git://gitenterprise.xilinx.com/Linux/arm-trusted-firmware.git \n \
git://github.com/Xilinx/device-tree-xlnx.git      git://gitenterprise.xilinx.com/Linux/device-tree-xlnx.git \n \
git://github.com/Xilinx/libdfx.git                git://gitenterprise.xilinx.com/Linux/libdfx.git \n \
git://github.com/Xilinx/linux-examples.git        git://gitenterprise.xilinx.com/Linux/linux-examples.git \n \
git://github.com/Xilinx/linux-xlnx.git            git://gitenterprise.xilinx.com/Linux/linux-xlnx.git \n \
git://github.com/Xilinx/u-boot-xlnx.git           git://gitenterprise.xilinx.com/Linux/u-boot-xlnx.git \n \
git://github.com/Xilinx/dfx-mgr.git               git://gitenterprise.xilinx.com/Madagascar/dfx-mgr.git \n \
git://github.com/Xilinx/libmetal.git              git://gitenterprise.xilinx.com/OpenAMP/libmetal.git \n \
git://github.com/Xilinx/open-amp.git               git://gitenterprise.xilinx.com/OpenAMP/open-amp.git \n \
git://github.com/Xilinx/qemu-devicetrees.git      git://gitenterprise.xilinx.com/QEMU/dts.git \n \
gitsm://github.com/Xilinx/qemu.git                  gitsm://gitenterprise.xilinx.com/QEMU/qemu.git \n \
git://github.com/Xilinx/aibox-reid.git            git://gitenterprise.xilinx.com/SOM/aibox-reid.git \n \
git://github.com/Xilinx/ap1302-firmware.git       git://gitenterprise.xilinx.com/SOM/ap1302-firmware.git \n \
git://github.com/Xilinx/axi-qos.git               git://gitenterprise.xilinx.com/SOM/axi-qos.git \n \
git://github.com/Xilinx/ddr-qos.git               git://gitenterprise.xilinx.com/SOM/ddr-qos.git \n \
git://github.com/Xilinx/defect-detect.git         git://gitenterprise.xilinx.com/SOM/defect-detect.git \n \
git://github.com/Xilinx/kria-apps-firmware.git    git://gitenterprise.xilinx.com/SOM/kria-apps-firmware.git \n \
git://github.com/Xilinx/linux-image_update.git    git://gitenterprise.xilinx.com/SOM/linux-image_update.git \n \
git://github.com/Xilinx/nlp-smartvision.git       git://gitenterprise.xilinx.com/SOM/nlp-smartvision.git \n \
git://github.com/Xilinx/xlnx_platformstats.git    git://gitenterprise.xilinx.com/SOM/xlnx_platformstats.git \n \
git://github.com/Xilinx/smartcam.git              git://gitenterprise.xilinx.com/SOM/smartcam.git \n \
git://github.com/Xilinx/xilinx-sw-converter-module.git  git://gitenterprise.xilinx.com/SOM/xilinx-sw-converter-module.git \n \
git://github.com/Xilinx/xmutil.git                git://gitenterprise.xilinx.com/SOM/xmutil.git \n \
git://github.com/Xilinx/runx.git                  git://gitenterprise.xilinx.com/Xen/runx.git \n \
git://github.com/Xilinx/xen.git                   git://gitenterprise.xilinx.com/Xen/xen.git \n \
git://github.com/Xilinx/vcu-ctrl-sw.git           git://gitenterprise.xilinx.com/xilinx-vcu/vcu-ctrl-sw.git \n \
git://github.com/Xilinx/vdu-ctrl-sw.git           git://gitenterprise.xilinx.com/xilinx-vcu/vdu-ctrl-sw.git \n \
git://github.com/Xilinx/vcu-firmware.git          git://gitenterprise.xilinx.com/xilinx-vcu/vcu-firmware.git \n \
git://github.com/Xilinx/vdu-firmware.git          git://gitenterprise.xilinx.com/xilinx-vcu/vdu-firmware.git \n \
git://github.com/Xilinx/vcu-modules.git           git://gitenterprise.xilinx.com/xilinx-vcu/vcu-modules.git \n \
git://github.com/Xilinx/vdu-modules.git           git://gitenterprise.xilinx.com/xilinx-vcu/vdu-modules.git \n \
git://github.com/Xilinx/vcu-omx-il.git            git://gitenterprise.xilinx.com/xilinx-vcu/vcu-omx-il.git \n \
git://github.com/Xilinx/vdu-omx-il.git            git://gitenterprise.xilinx.com/xilinx-vcu/vdu-omx-il.git \n \
git://github.com/Xilinx/hdf-examples.git          git://gitenterprise.xilinx.com/Yocto/hdf-examples.git \n \
git://github.com/Xilinx/system-controller-web.git git://gitenterprise.xilinx.com/PAEG/SystemController.git \n \
git://github.com/Xilinx/system-controller-app.git git://gitenterprise.xilinx.com/Platform-Management/system-controller.git \n \
git://github.com/Xilinx/system-controller-pmtool.git	git://gitenterprise.xilinx.com/PAEG/pmtool.git \n \
git://github.com/Xilinx/jupyter-pat.git           git://gitenterprise.xilinx.com/PowerAdvantageTool/jupyter-pat.git \n \
git://github.com/Xilinx/imagebuilder.git	  git://gitenterprise.xilinx.com/Xen/imagebuilder.git \n \
git://github.com/Xilinx/linux-examples.git git://gitenterprise.xilinx.com/Linux/linux-examples.git \n \
git://github.com/Xilinx/bootgen.git git://gitenterprise.xilinx.com/SDK/bootgen.git \n \
http://petalinux.xilinx.com/sswreleases/rel-v2020.2.2/source-tarballs/ivas.tar.gz file:///proj/yocto/ivas-2020.2.2/ivas.tar.gz \n \
git://github.com/xilinx/dp-modules.git            git://gitenterprise.xilinx.com/IPS-SSW/dp-modules \n \
git://github.com/Xilinx/kria-dashboard.git	  git://gitenterprise.xilinx.com/SOM/kria-dashboard.git \n \
git://github.com/Xilinx/platform-management-notebooks.git git://gitenterprise.xilinx.com/Platform-Management/oob-demos.git \n \
git://github.com/Xilinx/xlnx-board-id-data.git    git://gitenterprise.xilinx.com/SOM/xlnx-board-id-data \n \
git://github.com/Xilinx/embeddedsw-experimental-dt-support.git   git://gitenterprise.xilinx.com/decoupling/embeddedsw-experimental-dt-support.git \n \
git://github.com/Xilinx/mali-userspace-binaries.git git://gitenterprise.xilinx.com/Graphics/mali-userspace-binaries.git \n \
git://github.com/Xilinx/aie-rt.git                git://gitenterprise.xilinx.com/ai-engine/aie-rt.git \n \
git://github.com/Xilinx/kria-base-firmware.git    git://gitenterprise.xilinx.com/SOM/kria-base-firmware.git \n \
git://github.com/Xilinx/tsn-utils.git             git://gitenterprise.xilinx.com/Linux/tsn-utils.git \n \
gitsm://github.com/Xilinx/tsn-talker-listener.git   gitsm://gitenterprise.xilinx.com/Linux/tsn-talker-listener.git \n \
git://github.com/Xilinx/fru-tool.git              git://gitenterprise.xilinx.com/SOM/fru-tool.git \n \
git://github.com/Xilinx/pmod-rs485-test.git       git://gitenterprise.xilinx.com/SOM/pmod-rs485-test.git \n \
git://github.com/Xilinx/ros-tsn-pubsub.git        git://gitenterprise.xilinx.com/SOM/ros-tsn-pubsub.git \n \
git://github.com/Xilinx/VVAS.git                  git://gitenterprise.xilinx.com/IPS-SSW/vvas.git \n \
git://github.com/Xilinx/Vitis-AI.git              git://gitenterprise.xilinx.com/Vitis/vitis-ai-staging.git \n \
git://github.com/Xilinx/aibox-dist.git            git://gitenterprise.xilinx.com/som/aibox-dist.git \n \
git://github.com/Xilinx/systemctl-labtool.git     git://gitenterprise.xilinx.com/smartlynq/systemctl-labtool-yocto.git \n \
"
```
