## conf/distro/petalinux.conf
```bitbake
require conf/distro/poky.conf

# Reset the default set in poky, we want to set it ourselves in petalinux-features
unset INIT_MANAGER

require conf/distro/include/petalinux-features.conf
require conf/distro/include/petalinux-mirrors.conf
require conf/distro/include/petalinux-version.conf
include conf/distro/include/petalinux-feed.conf

DISTRO = "petalinux"
DISTRO_NAME = "PetaLinux"

# Define the ROS2 Yocto release
ROS_OE_RELEASE_SERIES = "scarthgap"

# Define ROS2 distro release
ROS_DISTRO = "jazzy"

# Follow the Poky format of <Version>+<type>-<date>
DISTRO_VERSION = "${XILINX_VER_MAIN}+${XILINX_VER_UPDATE}-${XILINX_VER_BUILD}"

SDK_VENDOR = "-petalinux"
SDK_VERSION := "${@'${XILINX_VER_MAIN}'.replace('snapshot-${DATE}','snapshot')}"

MAINTAINER = "AMD AECG <meta-xilinx@yoctoproject.org>"

TARGET_VENDOR = "-amd"

SANITY_TESTED_DISTROS:append = " \
	centos-7.4 \n \
	centos-7.5 \n \
	centos-7.6 \n \
	centos-7.7 \n \
	centos-7.9 \n \
	centos-8 \n \
	centos-8.2 \n \
	centos-8.3 \n \
	centos-8.4 \n \
	centos-8.5 \n \
	centos-8.6 \n \
	rhel-7.4 \n \
	rhel-7.5 \n \
	rhel-7.6 \n \
	rhel-7.7 \n \
	rhel-7.9 \n \
	rhel-8.2 \n \
	rhel-8.3 \n \
	rhel-8.4 \n \
	rhel-8.5 \n \
	rhel-8.6 \n \
	almalinux-8.10 \n \
	almalinux-9.4 \n \
	almalinux-9.5 \n \
	"

# Packages to skip
SKIP_RECIPE[distro-feed-configs] = "Not supported, see petalinux-image-common.inc for feed config."

# Verify the user's configuration is valid
INHERIT += "plnx-externalsrc"

# Add alternative mirrors for some components
INHERIT+="plnx-mirrors"

# Do not include clang in generated SDKs
CLANGSDK ?= "0"

# Configure default users/groups
# Default rules (assumed no debug-tweaks image feature):
# * disabled root login (set by system default)
# * Add a user 'petalinux' with no password
#   - SSH won't allow passwd-less login w/o debug tweaks, so requires console login
#   - Set to immediately expire
#   - Add to the sudoers file
# * Add 'petalinux' user to the audio group
# * Add 'petalinux' user to the video group
IMAGE_CLASSES += "extrausers"
EXTRA_USERS_PARAMS ?= "\
    useradd -p '' petalinux;passwd-expire petalinux; \
    groupadd -r aie; \
    usermod -a -G aie,audio,input,video petalinux; \
"
USERADDEXTENSION:append = " plnx-useradd-sudoers"
EXTRA_USERS_SUDOERS ?= "petalinux ALL=(ALL) ALL;"
```

## conf/layer.conf
```bitbake
# We have a conf and classes directory, add to BBPATH
BBPATH .= ":${LAYERDIR}"

# We need to override a class
# organize the files like oe-core to make them easier to manage
BBPATH =. "${LAYERDIR}/oe-core/meta:"
PETALINUX_COREBASE = "${LAYERDIR}/oe-core"

# Keep layer path so recipes can reference it
PETALINUX_PATH = "${LAYERDIR}"

# We have a packages directory, add to BBFILES
BBFILES += " \
		${LAYERDIR}/recipes-*/*/*.bb \
		${LAYERDIR}/recipes-*/*/*.bbappend"

BBFILES_DYNAMIC += " \
    provenrun:${LAYERDIR}/dynamic-layers/provenrun/recipes-*/*/*.bb \
    provenrun:${LAYERDIR}/dynamic-layers/provenrun/recipes-*/*/*.bbappend \
    xilinx-tools:${LAYERDIR}/dynamic-layers/xilinx-tools/recipes-*/*/*.bb \
    xilinx-tools:${LAYERDIR}/dynamic-layers/xilinx-tools/recipes-*/*/*.bbappend \
    xilinx:${LAYERDIR}/dynamic-layers/xilinx-core/recipes-*/*/*.bb \
    xilinx:${LAYERDIR}/dynamic-layers/xilinx-core/recipes-*/*/*.bbappend \
    xilinx-standalone-sdt:${LAYERDIR}/dynamic-layers/xilinx-standalone-sdt/recipes-*/*/*.bb \
    xilinx-standalone-sdt:${LAYERDIR}/dynamic-layers/xilinx-standalone-sdt/recipes-*/*/*.bbappend \
    xilinx-mali400:${LAYERDIR}/dynamic-layers/xilinx-mali400/recipes-*/*/*.bb \
    xilinx-mali400:${LAYERDIR}/dynamic-layers/xilinx-mali400/recipes-*/*/*.bbappend \
    "

BBFILE_COLLECTIONS += "petalinux"
BBFILE_PRIORITY_petalinux = "6"
BBFILE_PATTERN_petalinux := "^${LAYERDIR}/"

LAYERDEPENDS_petalinux = "\
    core \
    multimedia-layer \
    qt5-layer \
    xilinx \
    xilinx-standalone \
    "

LAYERRECOMMENDS_petalinux = "xilinx-tools xilinx-standalone-sdt provenrun"

# Sanity check for meta-petalinux layer.
# Setting SKIP_META_PETALINUX_SANITY_CHECK to "1" would skip the bbappend files check.
INHERIT += "plnx-sanity-meta-petalinux"

SIGGEN_EXCLUDERECIPES_ABISAFE += " \
	gcc-cross-xilinx \
	binutils-cross-xilinx \
	"

SIGGEN_EXCLUDE_SAFE_RECIPE_DEPS += " \
	base-files->base-files-plnx \
	base-files-plnx->base-files-board \
	base-files-plnx->base-files-board-variant \
	base-files-plnx->base-files-board-soc \
	"
BB_DANGLINGAPPENDS_WARNONLY = "true"

LAYERSERIES_COMPAT_petalinux = "scarthgap"

BBMASK += " \
	meta-ros/meta-ros2-humble/recipes-devtools/babeltrace/ \
	meta-ros/meta-ros2-jazzy/generated-recipes/fuse/ \
	meta-ros/meta-ros2-jazzy/recipes-bbappends/fuse/ \
	meta-ros/meta-ros2-jazzy/recipes-support/fuse/ \
	"
```

## conf/machine/microblazeel-v10.0-bs-cmp-mh-div-generic.conf
```bitbake
#@TYPE: Machine
#@NAME: microblazeel-v8.30-bs-cmp-mh-div
#@DESCRIPTION: microblazeel-v8.30-bs-cmp-mh-div

TARGET_CPU = "microblazeel"
MACHINE_FEATURES := ""

require conf/machine/include/tune-microblaze.inc
require conf/machine/include/machine-xilinx-default.inc

TUNE_FEATURES_tune-microblaze += "v10.0 little-endian barrel-shift pattern-compare divide-hard multiply-high"

KERNEL_IMAGETYPE = "linux.bin.ub"
SERIAL_CONSOLE = "115200 ttyS0"

EXTRA_IMAGEDEPENDS += "libyaml-native python3-cython-native python3-pyyaml-native"
```

## conf/machine/microblazeel-v10.0-bs-cmp-ml-generic.conf
```bitbake
#@TYPE: Machine
#@NAME: microblazeel-v8.30-bs-cmp-ml
#@DESCRIPTION: microblazeel-v8.30-bs-cmp-ml

TARGET_CPU = "microblazeel"
MACHINE_FEATURES := ""

require conf/machine/include/tune-microblaze.inc
require conf/machine/include/machine-xilinx-default.inc

TUNE_FEATURES_tune-microblaze += "v10.0 little-endian barrel-shift pattern-compare multiply-low"

KERNEL_IMAGETYPE = "linux.bin.ub"
SERIAL_CONSOLE = "115200 ttyS0"

EXTRA_IMAGEDEPENDS += "libyaml-native python3-cython-native python3-pyyaml-native"
```

## conf/machine/microblazeel-v8.30-bs-cmp-mh-div-generic.conf
```bitbake
#@TYPE: Machine
#@NAME: microblazeel-v8.30-bs-cmp-mh-div
#@DESCRIPTION: microblazeel-v8.30-bs-cmp-mh-div

TARGET_CPU = "microblazeel"
MACHINE_FEATURES := ""

require conf/machine/include/tune-microblaze.inc

TUNE_FEATURES_tune-microblaze += "v8.30 little-endian barrel-shift pattern-compare divide-hard multiply-high"

KERNEL_IMAGETYPE = "linux.bin.ub"
SERIAL_CONSOLE = "115200 ttyS0"
PREFERRED_PROVIDER_virtual/kernel="linux-dummy"
```

## conf/machine/riscv-tc.conf
```bitbake
require conf/machine/include/machine-xilinx-qemu.inc
require conf/multilib.conf
require conf/machine/include/riscv/tune-riscv.inc
require conf/machine/include/baremetal-tc.conf

# Set defaults
# We don't know why pie is not supported, but when enabled results in:
#   .../riscv32-xilinx-elf/12.2.0/ld: -pie not supported
GCCPIE:riscv-tc = ""
GLIBCPIE:riscv-tc = ""
SECURITY_CFLAGS:remove:riscv-tc = "${SECURITY_PIE_CFLAGS}"
SECURITY_CFLAGS:pn-libgcc:riscv-tc = ""

# Make 'riscv' a valid tune feature
TUNEVALID[riscv] = "Define the entire architecture family"
TUNE_CCARGS = "${TUNE_CCARGS:tune-${DEFAULTTUNE}}"

# Define all of the multilibs supproted by this configuration
MULTILIB_GLOBAL_VARIANTS = "${@extend_variants(d,'MULTILIBS','multilib')}"

# Original request:
# rv32i-ilp32--c;rv32im-ilp32--c;rv32imc-ilp32--;rv32iac-ilp32--;rv32imac-ilp32--;rv32imafc-ilp32f--;rv32imafdc-ilp32d--;rv64i-lp64--;rv64im-lp64--;rv64imac-lp64--;rv64imafdc-lp64d--

MULTILIBS  = ""
MULTILIBS += "multilib:librv32iilp32"
MULTILIBS += "multilib:librv32imilp32"
MULTILIBS += "multilib:librv32imcilp32"
MULTILIBS += "multilib:librv32iacilp32"
MULTILIBS += "multilib:librv32imacilp32"
MULTILIBS += "multilib:librv32imafcilp32f"
MULTILIBS += "multilib:librv32imafdcilp32d"
MULTILIBS += "multilib:librv64ilp64"
MULTILIBS += "multilib:librv64imlp64"
MULTILIBS += "multilib:librv64imaclp64"
MULTILIBS += "multilib:librv64imafdclp64d"

# Additional request:
# rv32imac_zicsr_zifencei-ilp32--;rv64imac_zicsr_zifencei-lp64--
MULTILIBS += "multilib:librv32imac_zicsr_zifenceiilp32"
MULTILIBS += "multilib:librv64imac_zicsr_zifenceilp64"

# Base configuration
# CFLAGS:
DEFAULTTUNE = "riscv"

AVAILTUNES += "riscv"
PACKAGE_EXTRA_ARCHS:tune-riscv = "${TUNE_PKGARCH:tune-riscv}"
BASE_LIB:tune-riscv = "lib"
TUNE_FEATURES:tune-riscv = "riscv"
TUNE_CCARGS:tune-riscv = ""
TUNE_PKGARCH:tune-riscv = "riscv32"
TUNE_ARCH:tune-riscv = "riscv32"


# rv32i/ilp32
# CFLAGS: -march=rv32i -mabi=ilp32
DEFAULTTUNE:virtclass-multilib-librv32iilp32 = "rv32iilp32"

AVAILTUNES += "rv32iilp32"
PACKAGE_EXTRA_ARCHS:tune-rv32iilp32 = "${TUNE_PKGARCH:tune-rv32iilp32}"
BASE_LIB:tune-rv32iilp32 = "lib/rv32i/ilp32"
TUNE_FEATURES:tune-rv32iilp32 = "riscv"
TUNE_CCARGS:tune-rv32iilp32 = " -march=rv32i -mabi=ilp32"
TUNE_PKGARCH:tune-rv32iilp32 = "rv32iilp32"
TUNE_ARCH:tune-rv32iilp32 = "riscv32"


# rv32im/ilp32
# CFLAGS: -march=rv32im -mabi=ilp32
DEFAULTTUNE:virtclass-multilib-librv32imilp32 = "rv32imilp32"

AVAILTUNES += "rv32imilp32"
PACKAGE_EXTRA_ARCHS:tune-rv32imilp32 = "${TUNE_PKGARCH:tune-rv32imilp32}"
BASE_LIB:tune-rv32imilp32 = "lib/rv32im/ilp32"
TUNE_FEATURES:tune-rv32imilp32 = "riscv"
TUNE_CCARGS:tune-rv32imilp32 = " -march=rv32im -mabi=ilp32"
TUNE_PKGARCH:tune-rv32imilp32 = "rv32imilp32"
TUNE_ARCH:tune-rv32imilp32 = "riscv32"


# rv32imc/ilp32
# CFLAGS: -march=rv32im -mabi=ilp32
DEFAULTTUNE:virtclass-multilib-librv32imcilp32 = "rv32imcilp32"

AVAILTUNES += "rv32imcilp32"
PACKAGE_EXTRA_ARCHS:tune-rv32imcilp32 = "${TUNE_PKGARCH:tune-rv32imcilp32}"
BASE_LIB:tune-rv32imcilp32 = "lib/rv32imc/ilp32"
TUNE_FEATURES:tune-rv32imcilp32 = "riscv"
TUNE_CCARGS:tune-rv32imcilp32 = " -march=rv32im -mabi=ilp32"
TUNE_PKGARCH:tune-rv32imcilp32 = "rv32imcilp32"
TUNE_ARCH:tune-rv32imcilp32 = "riscv32"


# rv32iac/ilp32
# CFLAGS: -march=rv32iac -mabi=ilp32
DEFAULTTUNE:virtclass-multilib-librv32iacilp32 = "rv32iacilp32"

AVAILTUNES += "rv32iacilp32"
PACKAGE_EXTRA_ARCHS:tune-rv32iacilp32 = "${TUNE_PKGARCH:tune-rv32iacilp32}"
BASE_LIB:tune-rv32iacilp32 = "lib/rv32iac/ilp32"
TUNE_FEATURES:tune-rv32iacilp32 = "riscv"
TUNE_CCARGS:tune-rv32iacilp32 = " -march=rv32iac -mabi=ilp32"
TUNE_PKGARCH:tune-rv32iacilp32 = "rv32iacilp32"
TUNE_ARCH:tune-rv32iacilp32 = "riscv32"


# rv32imac/ilp32
# CFLAGS: -march=rv32imac -mabi=ilp32
DEFAULTTUNE:virtclass-multilib-librv32imacilp32 = "rv32imacilp32"

AVAILTUNES += "rv32imacilp32"
PACKAGE_EXTRA_ARCHS:tune-rv32imacilp32 = "${TUNE_PKGARCH:tune-rv32imacilp32}"
BASE_LIB:tune-rv32imacilp32 = "lib/rv32imac/ilp32"
TUNE_FEATURES:tune-rv32imacilp32 = "riscv"
TUNE_CCARGS:tune-rv32imacilp32 = " -march=rv32imac -mabi=ilp32"
TUNE_PKGARCH:tune-rv32imacilp32 = "rv32imacilp32"
TUNE_ARCH:tune-rv32imacilp32 = "riscv32"


# rv32imafc/ilp32f
# CFLAGS: -march=rv32imafc -mabi=ilp32f
DEFAULTTUNE:virtclass-multilib-librv32imafcilp32f = "rv32imafcilp32f"

AVAILTUNES += "rv32imafcilp32f"
PACKAGE_EXTRA_ARCHS:tune-rv32imafcilp32f = "${TUNE_PKGARCH:tune-rv32imafcilp32f}"
BASE_LIB:tune-rv32imafcilp32f = "lib/rv32imafc/ilp32f"
TUNE_FEATURES:tune-rv32imafcilp32f = "riscv"
TUNE_CCARGS:tune-rv32imafcilp32f = " -march=rv32imafc -mabi=ilp32f"
TUNE_PKGARCH:tune-rv32imafcilp32f = "rv32imafcilp32f"
TUNE_ARCH:tune-rv32imafcilp32f = "riscv32"


# rv32imafdc/ilp32f
# CFLAGS: -march=rv32imafdc -mabi=ilp32d
DEFAULTTUNE:virtclass-multilib-librv32imafdcilp32d = "rv32imafdcilp32d"

AVAILTUNES += "rv32imafdcilp32d"
PACKAGE_EXTRA_ARCHS:tune-rv32imafdcilp32d = "${TUNE_PKGARCH:tune-rv32imafdcilp32d}"
BASE_LIB:tune-rv32imafdcilp32d = "lib/rv32imafdc/ilp32d"
TUNE_FEATURES:tune-rv32imafdcilp32d = "riscv"
TUNE_CCARGS:tune-rv32imafdcilp32d = " -march=rv32imafdc -mabi=ilp32d"
TUNE_PKGARCH:tune-rv32imafdcilp32d = "rv32imafdcilp32d"
TUNE_ARCH:tune-rv32imafdcilp32d = "riscv32"


# rv64i/lp64
# CFLAGS: -march=rv64i -mabi=lp64
DEFAULTTUNE:virtclass-multilib-librv64ilp64 = "rv64ilp64"

AVAILTUNES += "rv64ilp64"
PACKAGE_EXTRA_ARCHS:tune-rv64ilp64 = "${TUNE_PKGARCH:tune-rv64ilp64}"
BASE_LIB:tune-rv64ilp64 = "lib/rv64i/lp64"
TUNE_FEATURES:tune-rv64ilp64 = "riscv"
TUNE_CCARGS:tune-rv64ilp64 = " -march=rv64i -mabi=lp64"
TUNE_PKGARCH:tune-rv64ilp64 = "rv64ilp64"
TUNE_ARCH:tune-rv64ilp64 = "riscv64"


# rv64im/lp64
# CFLAGS: -march=rv64im -mabi=lp64
DEFAULTTUNE:virtclass-multilib-librv64imlp64 = "rv64imlp64"

AVAILTUNES += "rv64imlp64"
PACKAGE_EXTRA_ARCHS:tune-rv64imlp64 = "${TUNE_PKGARCH:tune-rv64imlp64}"
BASE_LIB:tune-rv64imlp64 = "lib/rv64im/lp64"
TUNE_FEATURES:tune-rv64imlp64 = "riscv"
TUNE_CCARGS:tune-rv64imlp64 = " -march=rv64im -mabi=lp64"
TUNE_PKGARCH:tune-rv64imlp64 = "rv64imlp64"
TUNE_ARCH:tune-rv64imlp64 = "riscv64"


# rv64imac/lp64
# CFLAGS: -march=rv64imac -mabi=lp64
DEFAULTTUNE:virtclass-multilib-librv64imaclp64 = "rv64imaclp64"

AVAILTUNES += "rv64imaclp64"
PACKAGE_EXTRA_ARCHS:tune-rv64imaclp64 = "${TUNE_PKGARCH:tune-rv64imaclp64}"
BASE_LIB:tune-rv64imaclp64 = "lib/rv64imac/lp64"
TUNE_FEATURES:tune-rv64imaclp64 = "riscv"
TUNE_CCARGS:tune-rv64imaclp64 = " -march=rv64imac -mabi=lp64"
TUNE_PKGARCH:tune-rv64imaclp64 = "rv64imaclp64"
TUNE_ARCH:tune-rv64imaclp64 = "riscv64"


# rv64imafdc/lp64d
# CFLAGS: -march=rv64imafdc -mabi=lp64d
DEFAULTTUNE:virtclass-multilib-librv64imafdclp64d = "rv64imafdclp64d"

AVAILTUNES += "rv64imafdclp64d"
PACKAGE_EXTRA_ARCHS:tune-rv64imafdclp64d = "${TUNE_PKGARCH:tune-rv64imafdclp64d}"
BASE_LIB:tune-rv64imafdclp64d = "lib/rv64imafdc/lp64d"
TUNE_FEATURES:tune-rv64imafdclp64d = "riscv"
TUNE_CCARGS:tune-rv64imafdclp64d = " -march=rv64imafdc -mabi=lp64d"
TUNE_PKGARCH:tune-rv64imafdclp64d = "rv64imafdclp64d"
TUNE_ARCH:tune-rv64imafdclp64d = "riscv64"


# rv32imac_zicsr_zifencei/ilp32
# CFLAGS: -march=rv32imac_zicsr_zifencei -mabi=ilp32
DEFAULTTUNE:virtclass-multilib-librv32imac_zicsr_zifenceiilp32 = "rv32imac_zicsr_zifenceiilp32"

AVAILTUNES += "rv32imac_zicsr_zifenceiilp32"
PACKAGE_EXTRA_ARCHS:tune-rv32imac_zicsr_zifenceiilp32 = "${TUNE_PKGARCH:tune-rv32imac_zicsr_zifenceiilp32}"
BASE_LIB:tune-rv32imac_zicsr_zifenceiilp32 = "lib/rv32imac_zicsr_zifencei/ilp32"
TUNE_FEATURES:tune-rv32imac_zicsr_zifenceiilp32 = "riscv"
TUNE_CCARGS:tune-rv32imac_zicsr_zifenceiilp32 = " -march=rv32imac_zicsr_zifencei -mabi=ilp32"
TUNE_PKGARCH:tune-rv32imac_zicsr_zifenceiilp32 = "rv32imac_zicsr_zifenceiilp32"
TUNE_ARCH:tune-rv32imac_zicsr_zifenceiilp32 = "riscv32"



# rv64imac_zicsr_zifencei/lp64
# CFLAGS: -march=rv64imac_zicsr_zifencei -mabi=lp64
DEFAULTTUNE:virtclass-multilib-librv64imac_zicsr_zifenceilp64 = "rv64imac_zicsr_zifenceilp64"

AVAILTUNES += "rv64imac_zicsr_zifenceilp64"
PACKAGE_EXTRA_ARCHS:tune-rv64imac_zicsr_zifenceilp64 = "${TUNE_PKGARCH:tune-rv64imac_zicsr_zifenceilp64}"
BASE_LIB:tune-rv64imac_zicsr_zifenceilp64 = "lib/rv64imac_zicsr_zifencei/lp64"
TUNE_FEATURES:tune-rv64imac_zicsr_zifenceilp64 = "riscv"
TUNE_CCARGS:tune-rv64imac_zicsr_zifenceilp64 = " -march=rv64imac_zicsr_zifencei -mabi=lp64"
TUNE_PKGARCH:tune-rv64imac_zicsr_zifenceilp64 = "rv64imac_zicsr_zifenceilp64"
TUNE_ARCH:tune-rv64imac_zicsr_zifenceilp64 = "riscv64"
```

## conf/machine/zynq-generic.conf
```bitbake
#@TYPE: Machine
#@NAME:
#@DESCRIPTION: zynq devices

require conf/machine/include/tune-zynq.inc

MACHINE_FEATURES = "rtc ext2 ext3 vfat usbhost usbgadget"

PREFERRED_PROVIDER_virtual/kernel="linux-dummy"
```

## conf/machine/zynqmp-generic.conf
```bitbake
#@TYPE: Machine
#@NAME:
#@DESCRIPTION: zynqmp devices

require conf/machine/include/tune-zynqmp.inc
require conf/machine/include/machine-xilinx-default.inc

MACHINE_FEATURES = "rtc ext2 ext3 vfat usbhost mali"

IMAGE_CLASSES_remove = "xilinx-bootbin"
```
